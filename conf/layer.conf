## conf/layer.conf
```bitbake
# We have a conf directory, append to BBPATH
BBPATH := "${BBPATH}:${LAYERDIR}"

# We have a recipes directory, add to BBFILES
BBFILES := "${BBFILES} ${LAYERDIR}/recipes*/*/*.bb \\
            ${LAYERDIR}/recipes*/*/*.bbappend"

BBFILE_COLLECTIONS += "jari"
BBFILE_PATTERN_jari := "^${LAYERDIR}/"
BBFILE_PRIORITY_jari = "10"
LAYERSERIES_COMPAT_jari = "kirkstone nanbield"
```
